## conf/local.conf
```bitbake
[main]
# SECURITY WARNING: keep the secret key used in production secret!
SECRET_KEY = '8i8j$^u$a6@7!52+8t&a1i6ne!_ay)rz4rfm#5&jb*wg$5-bb%'

# SECURITY WARNING: don't run with debug turned on in production!
DEBUG = True
```
